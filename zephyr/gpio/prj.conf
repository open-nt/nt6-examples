## CMakeLists.txt
```
# MIT License - see LICENSE
#
# Nt GPIO on a Zephyr board: an LED that blinks, and one that follows the user button. Build it for the
# MIMXRT1170-EVKB with west, for example:
#
#   west build -b mimxrt1170_evk/mimxrt1176/cm7 zephyr/gpio -- -DNT_ROOT=/path/to/Nt
cmake_minimum_required(VERSION 3.20)

# This repository is not a west workspace, so Nt is named as a module: pass -DNT_ROOT=<a checkout of Nt>
# (or set NT_ROOT in the environment).
set(NT_ROOT "$ENV{NT_ROOT}" CACHE PATH "A checkout of Nt, used as a Zephyr module")
if(NT_ROOT)
    list(APPEND ZEPHYR_EXTRA_MODULES ${NT_ROOT})
endif()

find_package(Zephyr REQUIRED HINTS $ENV{ZEPHYR_BASE})
project(nt_zephyr_gpio LANGUAGES CXX)

target_sources(app PRIVATE src/main.cpp)
target_link_libraries(app PRIVATE Nt::Core Nt::Gpio)
```

## prj.conf
```kconfig
# Nt needs C++17 with the full standard library; CONFIG_NT selects the rest.
CONFIG_CPP=y
CONFIG_STD_CPP17=y
CONFIG_NT=y
CONFIG_GPIO=y
CONFIG_NT_GPIO=y

# Nt allocates from the C library's heap, and its event loop runs on the main thread.
CONFIG_COMMON_LIBC_MALLOC_ARENA_SIZE=262144
CONFIG_MAIN_STACK_SIZE=16384
CONFIG_HEAP_MEM_POOL_SIZE=32768
```

## src/main.cpp
```c
// MIT License - see LICENSE
// Nt GPIO on Zephyr: the board's first LED blinks, its second LED is lit while the user button is held,
// and each press is printed. Lines are named by the devicetree: the aliases led0, led1 and sw0 carry
// their pins and flags, and a pin can also be named by its controller, as gpio9:3.
#include <QtCore/QCoreApplication>
#include <QtCore/QDebug>
#include <QtCore/QTimer>
#include <QtGpio/QGpioLine>

namespace {

bool openLine(QGpioLine &line, QGpioLine::Direction direction) {
    line.setDirection(direction);
    if (!line.open()) {
        qWarning() << line.lineName() << ":" << line.errorString();
        return false;
    }
    qInfo() << line.lineName() << (direction == QGpioLine::Input ? "input" : "output")
            << (direction == QGpioLine::Input ? (line.isEventDriven() ? "on interrupts" : "polled") : "");
    return true;
}

} // namespace

int main() {
    int argc = 1;
    char name[] = "gpio";
    char *argv[] = {name, nullptr};
    QCoreApplication app(argc, argv);

    QGpioLine blink(QStringLiteral("led0"));
    QGpioLine follow(QStringLiteral("led1"));
    QGpioLine button(QStringLiteral("sw0"));
    button.setDebounceInterval(20);
    const bool haveBlink = openLine(blink, QGpioLine::Output);
    const bool haveFollow = openLine(follow, QGpioLine::Output);
    if (!openLine(button, QGpioLine::Input))
        return 1;

    // The same pin by its controller's node label and number: GPIO9 pin 3 is the green LED of the EVKB.
    {
        QGpioLine byController(QStringLiteral("gpio9:3"));
        byController.setDirection(QGpioLine::Output);
        qInfo() << "gpio9:3" << (byController.open() ? "opens" : qPrintable(byController.errorString()));
    }

    int presses = 0;
    QObject::connect(&button, &QGpioLine::valueChanged, [&](bool pressed) {
        if (haveFollow)
            follow.setValue(pressed);
        if (pressed)
            ++presses;
        qInfo() << (pressed ? "button pressed" : "button released") << "presses:" << presses;
    });

    QTimer timer;
    bool on = false;
    QObject::connect(&timer, &QTimer::timeout, [&] {
        on = !on;
        if (haveBlink)
            blink.setValue(on);
    });
    timer.start(500);

    return app.exec();
}
```
