## CMakeLists.txt
```
# MIT License - see LICENSE
#
# A serial port on a Zephyr board with Nt SerialPort: lines written to a UART in loopback mode and read back. Build it
# for the MIMXRT1170-EVKB with west, for example:
#
#   west build -b mimxrt1170_evk/mimxrt1176/cm7 zephyr/serial -- -DNT_ROOT=/path/to/Nt
cmake_minimum_required(VERSION 3.20)

# This repository is not a west workspace, so Nt is named as a module: pass -DNT_ROOT=<a checkout of Nt>
# (or set NT_ROOT in the environment).
set(NT_ROOT "$ENV{NT_ROOT}" CACHE PATH "A checkout of Nt, used as a Zephyr module")
if(NT_ROOT)
    list(APPEND ZEPHYR_EXTRA_MODULES ${NT_ROOT})
endif()

find_package(Zephyr REQUIRED HINTS $ENV{ZEPHYR_BASE})
project(nt_zephyr_serial LANGUAGES CXX)

target_sources(app PRIVATE src/main.cpp)
target_link_libraries(app PRIVATE Nt::Core Nt::SerialPort)
```

## prj.conf
```kconfig
# Nt needs C++17 with the full standard library; CONFIG_NT selects the rest.
CONFIG_CPP=y
CONFIG_STD_CPP17=y
CONFIG_NT=y

# The UART drivers of Zephyr, and Nt SerialPort on them.
CONFIG_SERIAL=y
CONFIG_NT_SERIALPORT=y

# Nt allocates from the C library's heap, and its event loop runs on the main thread.
CONFIG_COMMON_LIBC_MALLOC_ARENA_SIZE=262144
CONFIG_MAIN_STACK_SIZE=16384
CONFIG_HEAP_MEM_POOL_SIZE=32768
```

## boards/mimxrt1170_evk_mimxrt1176_cm7.overlay
```dts
/* MIT License - see LICENSE */

/*
 * LPUART2, on D0 and D1 of the Arduino header, in the loopback mode of the LPUART: its receiver reads its own
 * transmitter, so the example needs no wiring. Delete nxp,loopback to talk to a device on D0 (RX) and D1 (TX).
 */
&lpuart2 {
	status = "okay";
	current-speed = <115200>;
	nxp,loopback;
};
```

## src/main.cpp
```c
// MIT License - see LICENSE
// Nt SerialPort on Zephyr: lists the UARTs of the board, opens one (lpuart2 on
// the MIMXRT1170-EVKB, which the overlay puts in loopback mode) and writes a
// line every second, which comes back through the UART and is printed. On a
// board without lpuart2, change the name to another port that availablePorts()
// lists; not the one of the console.
#include <QtCore/QCoreApplication>
#include <QtCore/QDebug>
#include <QtCore/QTimer>
#include <QtSerialPort/QSerialPort>
#include <QtSerialPort/QSerialPortInfo>

int main() {
  int argc = 1;
  char name[] = "serial";
  char *argv[] = {name, nullptr};
  QCoreApplication app(argc, argv);

  for (const QSerialPortInfo &info : QSerialPortInfo::availablePorts())
    qInfo() << "port" << info.portName() << info.systemLocation();

  QSerialPort port;
  port.setPortName(QStringLiteral("lpuart2"));
  port.setBaudRate(QSerialPort::Baud115200);
  QObject::connect(&port, &QSerialPort::readyRead, [&port] {
    while (port.canReadLine())
      qInfo() << "received" << port.readLine().trimmed();
  });
  QObject::connect(&port, &QSerialPort::errorOccurred,
                   [&port](QSerialPort::SerialPortError error) {
                     if (error != QSerialPort::NoError)
                       qWarning() << "error:" << port.errorString();
                   });
  if (!port.open(QIODevice::ReadWrite)) {
    qWarning() << "cannot open" << port.portName() << port.errorString();
    return 1;
  }
  qInfo() << "opened" << port.portName() << "at" << port.baudRate() << "baud";

  int counter = 0;
  QTimer timer;
  QObject::connect(&timer, &QTimer::timeout, [&] {
    const QByteArray line = "line " + QByteArray::number(counter++) + "\n";
    port.write(line);
    qInfo() << "sent    " << line.trimmed();
  });
  timer.start(1000);
  return app.exec();
}
```
