## CMakeLists.txt
```
# MIT License - see LICENSE
#
# Firmware updates over the air with Nt Device: the board runs under a watchdog, confirms a new image once it has
# reached the network, and downloads a newer signed image, which MCUboot boots after a reset. Set the URL in
# src/main.cpp, then build it with MCUboot for the MIMXRT1170-EVKB:
#
#   west build --sysbuild -b mimxrt1170_evk/mimxrt1176/cm7 zephyr/update -- -DZEPHYR_EXTRA_MODULES=/path/to/Nt
#
# (with sysbuild, -DNT_ROOT would only reach the sysbuild level; ZEPHYR_EXTRA_MODULES reaches every image)
#
# and serve a newer build's build/update/zephyr/zephyr.signed.bin (raise VERSION first) from that URL.
cmake_minimum_required(VERSION 3.20)

# This repository is not a west workspace, so Nt is named as a module: pass -DNT_ROOT=<a checkout of Nt>
# (or set NT_ROOT in the environment).
set(NT_ROOT "$ENV{NT_ROOT}" CACHE PATH "A checkout of Nt, used as a Zephyr module")
if(NT_ROOT)
    list(APPEND ZEPHYR_EXTRA_MODULES ${NT_ROOT})
endif()

find_package(Zephyr REQUIRED HINTS $ENV{ZEPHYR_BASE})
project(nt_zephyr_update LANGUAGES CXX)

target_sources(app PRIVATE src/main.cpp)
target_link_libraries(app PRIVATE Nt::Core Nt::Network Nt::Device)
```

## sysbuild.conf
```
# Build MCUboot next to the application, which is then signed for it.
SB_CONFIG_BOOTLOADER_MCUBOOT=y
```

## prj.conf
```kconfig
# Nt needs C++17 with the full standard library; CONFIG_NT selects the rest.
CONFIG_CPP=y
CONFIG_STD_CPP17=y
CONFIG_NT=y
CONFIG_NT_NETWORK=y

# Nt allocates from the C library's heap, and its event loop runs on the main thread.
CONFIG_COMMON_LIBC_MALLOC_ARENA_SIZE=1048576
CONFIG_MAIN_STACK_SIZE=16384
# The stacks of the threads that Nt starts (CONFIG_NT_THREAD_STACK_SIZE each) come from the kernel heap.
CONFIG_HEAP_MEM_POOL_SIZE=65536

CONFIG_NETWORKING=y
CONFIG_NET_IPV4=y
CONFIG_NET_TCP=y
CONFIG_NET_UDP=y
CONFIG_NET_SOCKETS=y
CONFIG_NET_DHCPV4=y
CONFIG_NET_CONFIG_SETTINGS=y
CONFIG_NET_CONFIG_NEED_IPV4=y
CONFIG_ZVFS_OPEN_MAX=32

# Print the address that DHCP leases to the board on the console.
CONFIG_LOG=y
CONFIG_NET_LOG=y
CONFIG_NET_CONFIG_LOG_LEVEL_INF=y
CONFIG_NET_DHCPV4_LOG_LEVEL_INF=y

# Larger packet and buffer pools; the defaults run out on a busy LAN.
CONFIG_NET_MAX_CONTEXTS=16
CONFIG_NET_MAX_CONN=16
CONFIG_NET_PKT_RX_COUNT=32
CONFIG_NET_PKT_TX_COUNT=32
CONFIG_NET_BUF_RX_COUNT=64
CONFIG_NET_BUF_TX_COUNT=64
CONFIG_NET_BUF_DATA_SIZE=1536

# Receive processing runs in the Ethernet interrupt; the default interrupt stack overflows.
CONFIG_ISR_STACK_SIZE=16384

# Nt Device: the watchdog, the reset cause, and updates for MCUboot.
CONFIG_NT_DEVICE=y
CONFIG_WATCHDOG=y
CONFIG_HWINFO=y
CONFIG_FLASH=y
CONFIG_FLASH_MAP=y
CONFIG_STREAM_FLASH=y
CONFIG_IMG_MANAGER=y
CONFIG_MCUBOOT_IMG_MANAGER=y
CONFIG_REBOOT=y
```

## src/main.cpp
```c
// MIT License - see LICENSE
// Firmware updates with Nt Device on Zephyr. The board runs under a watchdog
// that the event loop feeds. A new image runs on trial until it has reached the
// update server, and confirms itself then; if it hangs or cannot reach the
// network, the watchdog or a reset sends MCUboot back to the old image. It
// downloads the image at kImageUrl into the second slot and reboots into it if
// its version is newer than the running one.
#include <QtCore/QCoreApplication>
#include <QtCore/QDebug>
#include <QtCore/QTimer>
#include <QtDevice/QFirmwareUpdate>
#include <QtDevice/QWatchdog>
#include <QtNetwork/QNetworkAccessManager>
#include <QtNetwork/QNetworkReply>

namespace {
// Where a newer build's zephyr.signed.bin is served, for example with python3
// -m http.server.
const char kImageUrl[] = "http://192.168.1.10:8000/zephyr.signed.bin";
} // namespace

int main() {
  int argc = 1;
  char name[] = "update";
  char *argv[] = {name, nullptr};
  QCoreApplication app(argc, argv);

  QWatchdog watchdog;
  watchdog.setTimeout(10000);
  watchdog.setAutoFeed(true);
  if (watchdog.causedLastReset())
    qWarning() << "the watchdog reset the board";
  if (!watchdog.start())
    qWarning() << "no watchdog:" << watchdog.errorString();

  const QVersionNumber running = QFirmwareUpdate::runningVersion();
  const bool onTrial = !QFirmwareUpdate::isRunningImageConfirmed();
  qInfo() << "running firmware" << running
          << (onTrial ? "on trial" : "confirmed");

  QNetworkAccessManager manager;
  QFirmwareUpdate update;
  QNetworkReply *reply = nullptr;
  QObject::connect(&update, &QFirmwareUpdate::errorOccurred,
                   [&update](QFirmwareUpdate::UpdateError) {
                     qWarning() << "update:" << update.errorString();
                   });

  const auto check = [&] {
    reply = manager.get(QNetworkRequest(QUrl(QString::fromLatin1(kImageUrl))));
    QObject::connect(reply, &QNetworkReply::metaDataChanged, [&] {
      update.begin(
          reply->header(QNetworkRequest::ContentLengthHeader).toLongLong());
    });
    QObject::connect(reply, &QIODevice::readyRead,
                     [&] { update.writeFrom(reply); });
    QObject::connect(reply, &QNetworkReply::finished, [&] {
      reply->deleteLater();
      if (reply->error() != QNetworkReply::NoError) {
        qWarning() << "download failed:" << reply->errorString();
        update.abort();
        return;
      }
      // The server answered, so the network works: a new image has passed its
      // test.
      if (onTrial && QFirmwareUpdate::confirmRunningImage())
        qInfo() << "confirmed the running image";
      update.writeFrom(reply);
      if (!update.finish())
        return;
      qInfo() << "downloaded firmware" << update.imageVersion();
      if (update.imageVersion() <= running) {
        qInfo() << "not newer; staying on" << running;
        update.abort();
        return;
      }
      if (update.requestUpgrade()) {
        qInfo() << "rebooting into" << update.imageVersion();
        QTimer::singleShot(500, [] { QFirmwareUpdate::reboot(); });
      }
    });
  };
  QTimer::singleShot(5000, check); // after DHCP
  return app.exec();
}
```
