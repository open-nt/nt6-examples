## CMakeLists.txt
```
# MIT License - see LICENSE
#
# The sensors of a Zephyr board, listed and read every second with Nt Sensors. Build it for the MIMXRT1170-EVKB
# with west, for example:
#
#   west build -b mimxrt1170_evk/mimxrt1176/cm7 zephyr/sensors -- -DNT_ROOT=/path/to/Nt
cmake_minimum_required(VERSION 3.20)

# This repository is not a west workspace, so Nt is named as a module: pass -DNT_ROOT=<a checkout of Nt>
# (or set NT_ROOT in the environment).
set(NT_ROOT "$ENV{NT_ROOT}" CACHE PATH "A checkout of Nt, used as a Zephyr module")
if(NT_ROOT)
    list(APPEND ZEPHYR_EXTRA_MODULES ${NT_ROOT})
endif()

find_package(Zephyr REQUIRED HINTS $ENV{ZEPHYR_BASE})
project(nt_zephyr_sensors LANGUAGES CXX)

target_sources(app PRIVATE src/main.cpp)
target_link_libraries(app PRIVATE Nt::Core Nt::Sensors)
```

## prj.conf
```kconfig
# Nt needs C++17 with the full standard library; CONFIG_NT selects the rest.
CONFIG_CPP=y
CONFIG_STD_CPP17=y
CONFIG_NT=y

# The sensor drivers of Zephyr, and Nt Sensors on them. Name a sensor with a devicetree alias such as accel0 or
# ambient-temp0 (see the overlay in boards/), or set its device name as the identifier.
CONFIG_SENSOR=y
CONFIG_NT_SENSORS=y

# Nt allocates from the C library's heap, and its event loop runs on the main thread.
CONFIG_COMMON_LIBC_MALLOC_ARENA_SIZE=262144
CONFIG_MAIN_STACK_SIZE=16384
CONFIG_HEAP_MEM_POOL_SIZE=32768
```

## src/main.cpp
```c
// MIT License - see LICENSE
// Nt Sensors on Zephyr: lists the sensors that the devicetree names and prints a reading of each every second.
#include <QtCore/QCoreApplication>
#include <QtCore/QDebug>
#include <QtSensors/QSensor>

#include <memory>
#include <vector>

int main() {
    int argc = 1;
    char name[] = "sensors";
    char *argv[] = {name, nullptr};
    QCoreApplication app(argc, argv);

    std::vector<std::unique_ptr<QSensor>> sensors;
    for (const QByteArray &type : QSensor::sensorTypes()) {
        for (const QByteArray &id : QSensor::sensorsForType(type)) {
            auto sensor = std::make_unique<QSensor>(type);
            sensor->setIdentifier(id);
            sensor->setDataRate(1);
            QSensor *s = sensor.get();
            QObject::connect(s, &QSensor::readingChanged, [s] {
                QSensorReading *r = s->reading();
                QDebug line = qInfo().nospace();
                line << s->type() << " " << s->identifier() << ":";
                for (int i = 0; i < r->valueCount(); ++i)
                    line << " " << r->value(i).toDouble();
            });
            QObject::connect(s, &QSensor::sensorError, [s](int error) { qWarning() << s->identifier() << "error" << error; });
            if (s->start())
                qInfo() << "reading" << type << id;
            sensors.push_back(std::move(sensor));
        }
    }
    if (sensors.empty())
        qInfo() << "no sensors: give one a devicetree alias such as accel0 or ambient-temp0";
    return app.exec();
}
```
