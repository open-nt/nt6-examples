## CMakeLists.txt
```
# MIT License - see LICENSE
#
# A headset on the audio codec of a Zephyr board: the microphone set up for its impedance, its level and button
# reported, and its sound played back on the headphones. Build it for the MIMXRT1170-EVKB with west, for example:
#
#   west build -b mimxrt1170_evk/mimxrt1176/cm7 zephyr/headset -- -DNT_ROOT=/path/to/Nt
cmake_minimum_required(VERSION 3.20)

# This repository is not a west workspace, so Nt is named as a module: pass -DNT_ROOT=<a checkout of Nt>
# (or set NT_ROOT in the environment).
set(NT_ROOT "$ENV{NT_ROOT}" CACHE PATH "A checkout of Nt, used as a Zephyr module")
if(NT_ROOT)
    list(APPEND ZEPHYR_EXTRA_MODULES ${NT_ROOT})
endif()

find_package(Zephyr REQUIRED HINTS $ENV{ZEPHYR_BASE})
project(nt_zephyr_headset LANGUAGES CXX)

target_sources(app PRIVATE src/main.cpp)
target_link_libraries(app PRIVATE Nt::Core Nt::Multimedia)
```

## Kconfig
```
# MIT License - see LICENSE

mainmenu "Nt headset sample"

config APP_MIC_IMPEDANCE
	int "Impedance of the headset microphone, in ohms"
	default 2200
	help
	  Below 1000 ohms the microphone is taken to be dynamic (no bias, more gain); from 1000 up an
	  electret capsule (bias, less gain). 0 leaves the codec's settings as they are.

config APP_MIC_GAIN
	int "Microphone gain in dB, or -100 for what suits the impedance"
	default -100

config APP_SIDETONE
	bool "Play the microphone back on the headphones"
	default y

source "Kconfig.zephyr"
```

## prj.conf
```kconfig
# Nt needs C++17 with the full standard library; CONFIG_NT selects the rest.
CONFIG_CPP=y
CONFIG_STD_CPP17=y
CONFIG_NT=y

# The codec over I2C and its samples over I2S (SAI1 on the i.MX RT1170).
CONFIG_I2C=y
CONFIG_I2S=y
CONFIG_AUDIO=y
CONFIG_AUDIO_CODEC=y
CONFIG_NT_MULTIMEDIA=y

# Nt allocates from the C library's heap, and its event loop runs on the main thread.
CONFIG_COMMON_LIBC_MALLOC_ARENA_SIZE=1048576
CONFIG_MAIN_STACK_SIZE=16384
# The stacks of the threads that Nt starts (CONFIG_NT_THREAD_STACK_SIZE each) come from the kernel heap: the audio
# engine and one for each stream.
CONFIG_HEAP_MEM_POOL_SIZE=131072
CONFIG_LOG=y
```

## src/main.cpp
```c
// MIT License - see LICENSE
// Nt on Zephyr: a headset on the audio codec. The microphone is set up for the impedance in prj.conf (or
// CONFIG_APP_MIC_IMPEDANCE), its level is printed every second with the plugging and the button of the headset, and
// what it picks up is played back on the headphones, so that the bias and gain can be judged by ear.
#include <QtCore/QCoreApplication>
#include <QtCore/QDebug>
#include <QtCore/QTimer>
#include <QtMultimedia/QAudioHeadset>
#include <QtMultimedia/QAudioSink>
#include <QtMultimedia/QAudioSource>
#include <QtMultimedia/QMediaDevices>

#include <cmath>
#include <cstring>

int main() {
    int argc = 1;
    char name[] = "headset";
    char *argv[] = {name, nullptr};
    QCoreApplication app(argc, argv);

    const QAudioDevice input = QMediaDevices::defaultAudioInput();
    const QAudioDevice output = QMediaDevices::defaultAudioOutput();
    qInfo() << "input:" << input.description() << " output:" << output.description();
    if (input.isNull() || output.isNull()) {
        qWarning() << "no audio codec in the devicetree";
        return 1;
    }

    QAudioHeadset headset;
    if (!headset.isAvailable()) {
        qWarning() << "this codec has no headset control";
    } else {
        headset.setMicrophoneImpedance(CONFIG_APP_MIC_IMPEDANCE);
        if (CONFIG_APP_MIC_GAIN > -100)
            headset.setMicrophoneGain(float(CONFIG_APP_MIC_GAIN));
        qInfo() << headset.codecName() << "microphone:" << headset.microphoneImpedance() << "ohm, bias"
                << headset.microphoneBias() << "gain" << headset.microphoneGain() << "dB on input"
                << headset.microphoneInput() << headset.microphoneChannel();
        QObject::connect(&headset, &QAudioHeadset::microphoneConnectedChanged,
                         [](bool on) { qInfo() << (on ? "microphone plugged in" : "microphone unplugged"); });
        QObject::connect(&headset, &QAudioHeadset::buttonPressedChanged,
                         [](bool on) { qInfo() << (on ? "button pressed" : "button released"); });
        QObject::connect(&headset, &QAudioHeadset::errorOccurred, [&headset] { qWarning() << headset.errorString(); });
    }

    QAudioFormat format;
    format.setSampleRate(16000);
    format.setChannelCount(1);
    format.setSampleFormat(QAudioFormat::Int16);

    QAudioSource source(input, format);
    QAudioSink sink(output, format);
    QIODevice *mic = source.start();
    QIODevice *headphones = CONFIG_APP_SIDETONE ? sink.start() : nullptr;
    if (!mic) {
        qWarning() << "cannot record:" << source.error();
        return 1;
    }

    double sumSquares = 0;
    qint64 samples = 0;
    QObject::connect(mic, &QIODevice::readyRead, [&] {
        const QByteArray data = mic->readAll();
        const auto count = data.size() / qsizetype(sizeof(qint16));
        for (qsizetype i = 0; i < count; ++i) {
            qint16 sample;
            std::memcpy(&sample, data.constData() + i * qsizetype(sizeof(qint16)), sizeof(sample));
            sumSquares += double(sample) * double(sample);
        }
        samples += count;
        if (headphones)
            headphones->write(data);
    });

    QTimer meter;
    QObject::connect(&meter, &QTimer::timeout, [&] {
        const double rms = samples ? std::sqrt(sumSquares / double(samples)) : 0.0;
        const double dbfs = rms > 0 ? 20.0 * std::log10(rms / 32768.0) : -120.0;
        qInfo().nospace() << "level " << QString::number(dbfs, 'f', 1) << " dBFS over " << samples << " samples"
                          << (headset.isMicrophoneConnected() ? ", microphone sensed" : "");
        sumSquares = 0;
        samples = 0;
    });
    meter.start(1000);

    return app.exec();
}
```
