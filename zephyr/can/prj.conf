## CMakeLists.txt
```
# MIT License - see LICENSE
#
# CAN on a Zephyr board with Nt SerialBus: frames sent every second in loopback mode and read back. Build it for the MIMXRT1170-EVKB
# with west, for example:
#
#   west build -b mimxrt1170_evk/mimxrt1176/cm7 zephyr/can -- -DNT_ROOT=/path/to/Nt
cmake_minimum_required(VERSION 3.20)

# This repository is not a west workspace, so Nt is named as a module: pass -DNT_ROOT=<a checkout of Nt>
# (or set NT_ROOT in the environment).
set(NT_ROOT "$ENV{NT_ROOT}" CACHE PATH "A checkout of Nt, used as a Zephyr module")
if(NT_ROOT)
    list(APPEND ZEPHYR_EXTRA_MODULES ${NT_ROOT})
endif()

find_package(Zephyr REQUIRED HINTS $ENV{ZEPHYR_BASE})
project(nt_zephyr_can LANGUAGES CXX)

target_sources(app PRIVATE src/main.cpp)
target_link_libraries(app PRIVATE Nt::Core Nt::SerialBus)
```

## prj.conf
```kconfig
# Nt needs C++17 with the full standard library; CONFIG_NT selects the rest.
CONFIG_CPP=y
CONFIG_STD_CPP17=y
CONFIG_NT=y

# The CAN drivers of Zephyr, and Nt SerialBus on them.
CONFIG_CAN=y
CONFIG_CAN_FD_MODE=y
CONFIG_NT_SERIALBUS=y

# Nt allocates from the C library's heap, and its event loop runs on the main thread.
CONFIG_COMMON_LIBC_MALLOC_ARENA_SIZE=262144
CONFIG_MAIN_STACK_SIZE=16384
CONFIG_HEAP_MEM_POOL_SIZE=32768
```

## src/main.cpp
```c
// MIT License - see LICENSE
// Nt SerialBus on Zephyr: the CAN controller that zephyr,canbus chooses (FlexCAN3 on the MIMXRT1170-EVKB) in
// loopback mode, so that it needs neither a transceiver nor a bus. A frame goes out every second and comes back
// through the controller; set LoopbackKey to false to send onto a real bus at 500 kbit/s.
#include <QtCore/QCoreApplication>
#include <QtCore/QDebug>
#include <QtCore/QTimer>
#include <QtSerialBus/QCanBus>
#include <QtSerialBus/QCanBusDevice>

#include <memory>

int main() {
    int argc = 1;
    char name[] = "can";
    char *argv[] = {name, nullptr};
    QCoreApplication app(argc, argv);

    for (const QCanBusDeviceInfo &info : QCanBus::instance()->availableDevices(QStringLiteral("zephyrcan")))
        qInfo() << "controller" << info.name() << info.description() << (info.hasFlexibleDataRate() ? "CAN FD" : "");

    QString error;
    std::unique_ptr<QCanBusDevice> device(
        QCanBus::instance()->createDevice(QStringLiteral("zephyrcan"), QStringLiteral("canbus"), &error));
    if (!device) {
        qWarning() << error;
        return 1;
    }
    device->setConfigurationParameter(QCanBusDevice::LoopbackKey, true);
    device->setConfigurationParameter(QCanBusDevice::BitRateKey, 500000);
    QObject::connect(device.get(), &QCanBusDevice::framesReceived, [&device] {
        for (const QCanBusFrame &frame : device->readAllFrames()) {
            if (frame.frameType() == QCanBusFrame::ErrorFrame)
                qInfo() << "error frame:" << device->interpretErrorFrame(frame);
            else
                qInfo() << "received" << frame.toString();
        }
    });
    QObject::connect(device.get(), &QCanBusDevice::errorOccurred,
                     [&device](QCanBusDevice::CanBusError) { qWarning() << device->errorString(); });
    if (!device->connectDevice()) {
        qWarning() << "cannot connect:" << device->errorString();
        return 1;
    }
    qInfo() << "connected; bus status" << int(device->busStatus());

    quint8 counter = 0;
    QTimer timer;
    QObject::connect(&timer, &QTimer::timeout, [&] {
        QCanBusFrame frame(0x123, QByteArray(1, char(counter++)));
        if (device->writeFrame(frame))
            qInfo() << "sent    " << frame.toString();
    });
    timer.start(1000);
    return app.exec();
}
```
