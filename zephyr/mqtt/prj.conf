## CMakeLists.txt
```
# MIT License - see LICENSE
#
# MQTT on a Zephyr board with Nt Mqtt: the board publishes its uptime to a broker and answers commands. Set the
# address of the broker in src/main.cpp, then build it for the MIMXRT1170-EVKB with west, for example:
#
#   west build -b mimxrt1170_evk/mimxrt1176/cm7 zephyr/mqtt -- -DNT_ROOT=/path/to/Nt
cmake_minimum_required(VERSION 3.20)

# This repository is not a west workspace, so Nt is named as a module: pass -DNT_ROOT=<a checkout of Nt>
# (or set NT_ROOT in the environment).
set(NT_ROOT "$ENV{NT_ROOT}" CACHE PATH "A checkout of Nt, used as a Zephyr module")
if(NT_ROOT)
    list(APPEND ZEPHYR_EXTRA_MODULES ${NT_ROOT})
endif()

find_package(Zephyr REQUIRED HINTS $ENV{ZEPHYR_BASE})
project(nt_zephyr_mqtt LANGUAGES CXX)

target_sources(app PRIVATE src/main.cpp)
target_link_libraries(app PRIVATE Nt::Core Nt::Network Nt::Mqtt)
```

## prj.conf
```kconfig
# Nt needs C++17 with the full standard library; CONFIG_NT selects the rest.
CONFIG_CPP=y
CONFIG_STD_CPP17=y
CONFIG_NT=y
CONFIG_NT_NETWORK=y
CONFIG_NT_MQTT=y

# Nt allocates from the C library's heap, and its event loop runs on the main thread.
CONFIG_COMMON_LIBC_MALLOC_ARENA_SIZE=1048576
CONFIG_MAIN_STACK_SIZE=16384
# The stacks of the threads that Nt starts (CONFIG_NT_THREAD_STACK_SIZE each) come from the kernel heap.
CONFIG_HEAP_MEM_POOL_SIZE=65536

CONFIG_NETWORKING=y
CONFIG_NET_IPV4=y
CONFIG_NET_TCP=y
CONFIG_NET_UDP=y
CONFIG_NET_SOCKETS=y
CONFIG_NET_DHCPV4=y
CONFIG_NET_CONFIG_SETTINGS=y
CONFIG_NET_CONFIG_NEED_IPV4=y
CONFIG_ZVFS_OPEN_MAX=32

# Print the address that DHCP leases to the board on the console.
CONFIG_LOG=y
CONFIG_NET_LOG=y
CONFIG_NET_CONFIG_LOG_LEVEL_INF=y
CONFIG_NET_DHCPV4_LOG_LEVEL_INF=y

# Larger packet and buffer pools; the defaults run out on a busy LAN.
CONFIG_NET_MAX_CONTEXTS=16
CONFIG_NET_MAX_CONN=16
CONFIG_NET_PKT_RX_COUNT=32
CONFIG_NET_PKT_TX_COUNT=32
CONFIG_NET_BUF_RX_COUNT=64
CONFIG_NET_BUF_TX_COUNT=64
CONFIG_NET_BUF_DATA_SIZE=1536

# Receive processing runs in the Ethernet interrupt; the default interrupt stack overflows.
CONFIG_ISR_STACK_SIZE=16384
```

## src/main.cpp
```c
// MIT License - see LICENSE
// Nt Mqtt on Zephyr: the board gets an address with DHCP, connects to an MQTT
// broker, announces itself on nt/<id>/status (retained, with "offline" as its
// last will), publishes its uptime every five seconds on nt/<id>/uptime and
// prints what arrives on nt/<id>/commands/#. Try it with Mosquitto on the host:
//
//   mosquitto -v -c <(printf 'listener 1883\nallow_anonymous true\n')
//   mosquitto_sub -t 'nt/#' -v
//   mosquitto_pub -t nt/evkb-1/commands/hello -m world
#include <QtCore/QCoreApplication>
#include <QtCore/QDebug>
#include <QtCore/QElapsedTimer>
#include <QtCore/QTimer>
#include <QtMqtt/QMqttClient>

namespace {
// The address of the broker. Change it to that of the machine that runs
// Mosquitto.
const char kBroker[] = "192.168.1.10";
// The client identifier. A board without an entropy driver needs one of its
// own, since the random one that QMqttClient makes otherwise comes from
// QRandomGenerator::system().
const char kClientId[] = "evkb-1";
} // namespace

int main() {
  int argc = 1;
  char name[] = "mqtt";
  char *argv[] = {name, nullptr};
  QCoreApplication app(argc, argv);

  const QString id = QString::fromLatin1(kClientId);
  const QString status = QStringLiteral("nt/%1/status").arg(id);
  QMqttClient client;
  client.setHostname(QString::fromLatin1(kBroker));
  client.setPort(1883);
  client.setClientId(id);
  client.setWillTopic(status);
  client.setWillMessage("offline");
  client.setWillRetain(true);

  QElapsedTimer uptime;
  uptime.start();
  QTimer telemetry;
  QObject::connect(&telemetry, &QTimer::timeout, [&] {
    client.publish(QMqttTopicName(QStringLiteral("nt/%1/uptime").arg(id)),
                   QByteArray::number(uptime.elapsed() / 1000));
  });

  QObject::connect(&client, &QMqttClient::connected, [&] {
    qInfo() << "connected to" << client.hostname() << "as" << client.clientId();
    client.publish(QMqttTopicName(status), "online", 1, true);
    QMqttSubscription *commands = client.subscribe(
        QMqttTopicFilter(QStringLiteral("nt/%1/commands/#").arg(id)), 1);
    QObject::connect(commands, &QMqttSubscription::messageReceived,
                     [](const QMqttMessage &message) {
                       qInfo() << "command" << message.topic().name()
                               << message.payload();
                     });
    telemetry.start(5000);
  });
  // Reconnect after a failure, for example while the network comes up.
  QObject::connect(&client, &QMqttClient::disconnected, [&] {
    telemetry.stop();
    qWarning() << "disconnected, error" << client.error()
               << "- retrying in 5 s";
    QTimer::singleShot(5000, &client, &QMqttClient::connectToHost);
  });
  QTimer::singleShot(3000, &client, &QMqttClient::connectToHost); // after DHCP
  return app.exec();
}
```
